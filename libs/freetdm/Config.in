## libs/freetdm/Config.in
```kconfig
menu "Configuration"
	depends on PACKAGE_freetdm

config FREETDM_WITH_DEBUG
	bool "Compile with debug information"
	default n
	help
	  Enable extra debug codepaths, like asserts and extra output. If you
	  want to get meaningful backtraces see
	  https://wiki.openwrt.org/doc/devel/debugging for starting points.

endmenu
```

## net/asterisk-15.x/Config.in
```kconfig
menu "Advanced configuration"
	depends on PACKAGE_asterisk15

config ASTERISK15_LOW_MEMORY
	bool "Optimize Asterisk 15 for low memory usage"
	default n
	help
	  Warning: this feature is known to cause problems with some modules.
	  Disable it if you experience problems like segmentation faults.

endmenu
```

## net/baresip/Config.in
```kconfig
menu "bareSIP configuration"
	depends on PACKAGE_baresip

config BARESIP_WITH_FFMPEG
	bool "Compile with FFmpeg support"
	default y if (x86_64)
	help
	  The sole purpose of this symbol is to prevent that the bareSIP
	  video modules, the ones which depend on FFmpeg, are built by
	  default. The reason is that FFmpeg often fails to compile for
	  some targets, causing the bareSIP compile to fail as well.

	  If you want the modules which depend on FFmpeg to become
	  available, select 'y'.

endmenu
```

## net/freeswitch-stable/Config.in
```kconfig
menu "Advanced configuration"
	depends on PACKAGE_freeswitch-stable

config FS_STABLE_WITH_DEBUG
	bool "Compile with debug information"
	default n
	help
	  Enable extra debug codepaths, like asserts and extra output. If you
	  want to get meaningful backtraces see
	  https://wiki.openwrt.org/doc/devel/debugging for starting points.

config FS_STABLE_WITH_FREETYPE
	bool "Compile with FreeType support"
	default n
	help
	  Add FreeType support to FreeSWITCH

config FS_STABLE_WITH_LIBEDIT
	bool "Compile with libedit support"
	default y
	help
	  Compile with libedit support to enable command-line history editing
	  and curses functionality. Of course this feels nicer when interacting
	  with FreeSWITCH (without it it doesn't feel very interactive at all),
	  but it adds additional dependencies (libedit, libncursesw, terminfo).

config FS_STABLE_WITH_LIBYUV
	bool "Compile with libyuv support"
	default n
	help
	  Add libyuv support to FreeSWITCH

config FS_STABLE_WITH_ODBC
	bool "Compile with ODBC support"
	default n
	help
	  Enable ODBC support.

config FS_STABLE_WITH_PGSQL
	bool "Compile with PGSQL support"
	default n
	help
	  Enable PostgreSQL support.

config FS_STABLE_WITH_PNG
	bool "Compile with PNG support"
	default n
	help
	  Add PNG support to FreeSWITCH

config FS_STABLE_WITH_SRTP
	bool "Compile with SRTP support"
	default y
	help
	  Compile with SRTP support.

config FS_STABLE_WITH_VPX
	bool "Compile with VPx support"
	default n
	help
	  Compile with VPx video codec support

config FS_STABLE_WITH_ZRTP
	bool "Compile with ZRTP support"
	default n
	help
	  Compile with ZRTP support.

endmenu
```

## net/freeswitch/Config.in
```kconfig
menu "Advanced configuration"
	depends on PACKAGE_freeswitch

config FS_WITH_DEBUG
	bool "Compile with debug information"
	default n
	help
	  Enable extra debug codepaths, like asserts and extra output. If you
	  want to get meaningful backtraces see
	  https://wiki.openwrt.org/doc/devel/debugging for starting points.

config FS_WITH_FREETYPE
	bool "Compile with FreeType support"
	default y if x86_64
	help
	  Add FreeType support to FreeSWITCH

config FS_WITH_LIBYUV
	bool "Compile with libyuv support"
	default y if x86_64
	help
	  Add libyuv support to FreeSWITCH

config FS_WITH_ODBC
	bool "Compile with ODBC support"
	default y if x86_64
	help
	  Enable ODBC support.

config FS_WITH_PNG
	bool "Compile with PNG support"
	default y if x86_64
	help
	  Add PNG support to FreeSWITCH

config FS_WITH_SRTP
	bool "Compile with SRTP support"
	default y
	help
	  Compile with SRTP support.

config FS_WITH_VPX
	bool "Compile with VPx support"
	depends on FS_WITH_LIBYUV
	default y if x86_64
	help
	  Compile with VPx video codec support

config FS_WITH_ZRTP
	bool "Compile with ZRTP support"
	depends on aarch64||aarch64_be||arm||armeb||i386||mips||mips64||mips64el||mipsel||powerpc||powerpc64||powerpcle||sparc||x86_64
	default y if x86_64
	help
	  Compile with ZRTP support.

config FS_WITH_MODCONF
	bool "Include module examples"
	default y if x86_64
	help
	  Some modules include examples in their source directory, e.g. xml
	  snippets. Select y to include them.

endmenu
```
